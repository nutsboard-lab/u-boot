// SPDX-License-Identifier: GPL-2.0
//
// Copyright (C) 2015 Freescale Semiconductor, Inc.

/dts-v1/;

#include "imx6ul.dtsi"
#include "imx6ul-14x14-evk.dtsi"

/ {
	model = "MayQueen Panzer Box PC";
	compatible = "fsl,imx6ul-14x14-evk", "fsl,imx6ul";
};
